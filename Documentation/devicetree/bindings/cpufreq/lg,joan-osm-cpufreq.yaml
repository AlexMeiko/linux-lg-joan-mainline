## Documentation/devicetree/bindings/cpufreq/lg,joan-osm-cpufreq.yaml
```yaml
# SPDX-License-Identifier: (GPL-2.0-only OR BSD-2-Clause)
%YAML 1.2
---
$id: http://devicetree.org/schemas/cpufreq/lg,joan-osm-cpufreq.yaml#
$schema: http://devicetree.org/meta-schemas/core.yaml#

title: LG V30 MSM8998 OSM CPU frequency controller

maintainers:
  - GuWolf <admin@guwolf.com>

description: |
  The MSM8998 OSM v2 blocks on the LG V30 are not initialized by the boot
  firmware. The operating points and open-loop voltages are derived from
  per-device QFPROM data before the two CPRH and OSM domains are enabled.

properties:
  compatible:
    const: lg,joan-osm-cpufreq

  reg:
    minItems: 6
    maxItems: 6

  reg-names:
    items:
      - const: osm
      - const: power-cprh
      - const: performance-cprh
      - const: power-acd
      - const: performance-acd
      - const: apcs-common

  clocks:
    minItems: 3
    maxItems: 3

  clock-names:
    items:
      - const: cpr
      - const: aux
      - const: xo

  nvmem-cells:
    minItems: 8
    maxItems: 8

  nvmem-cell-names:
    items:
      - const: row38
      - const: row39
      - const: row67
      - const: row68
      - const: row69
      - const: row70
      - const: row71
      - const: row100

required:
  - compatible
  - reg
  - reg-names
  - clocks
  - clock-names
  - nvmem-cells
  - nvmem-cell-names

additionalProperties: false

examples:
  - |
    #include <dt-bindings/clock/qcom,gcc-msm8998.h>
    #include <dt-bindings/clock/qcom,rpmcc.h>

    cpufreq@179c0000 {
        compatible = "lg,joan-osm-cpufreq";
        reg = <0x179c0000 0x4000>,
              <0x179c8000 0x4000>,
              <0x179c4000 0x4000>,
              <0x17914800 0x800>,
              <0x17814800 0x800>,
              <0x179d1000 0x1000>;
        reg-names = "osm", "power-cprh", "performance-cprh",
                    "power-acd", "performance-acd", "apcs-common";

        clocks = <&gcc GCC_HMSS_RBCPR_CLK>,
                 <&gcc HMSS_GPLL0_CLK_SRC>,
                 <&rpmcc RPM_SMD_XO_CLK_SRC>;
        clock-names = "cpr", "aux", "xo";

        nvmem-cells = <&cpr_fuse_row38>, <&cpr_fuse_row39>,
                      <&cpr_fuse_row67>, <&cpr_fuse_row68>,
                      <&cpr_fuse_row69>, <&cpr_fuse_row70>,
                      <&cpr_fuse_row71>, <&cpr_fuse_row100>;
        nvmem-cell-names = "row38", "row39", "row67", "row68",
                           "row69", "row70", "row71", "row100";
    };
```

## Documentation/devicetree/bindings/power/supply/qcom,pmi8998-fg.yaml
```yaml
# SPDX-License-Identifier: (GPL-2.0-only OR BSD-2-Clause)
%YAML 1.2
---
$id: http://devicetree.org/schemas/power/supply/qcom,pmi8998-fg.yaml#
$schema: http://devicetree.org/meta-schemas/core.yaml#

title: Qualcomm PMI8998 fuel gauge

maintainers:
  - GuWolf <admin@guwolf.com>

description: |
  Qualcomm PMI8998 FG Gen3 exposes battery data through the BATT_SOC
  and BATT_INFO shadow peripherals. The BATT_SOC peripheral is located at
  the node base address, while BATT_INFO is fixed at base + 0x100.

properties:
  compatible:
    const: qcom,pmi8998-fg

  reg:
    maxItems: 1
    description: >-
      Base address of the BATT_SOC peripheral. The BATT_INFO peripheral
      is fixed at base + 0x100.

  monitored-battery: true

  power-supplies:
    maxItems: 1

required:
  - compatible
  - reg
  - monitored-battery
  - power-supplies

allOf:
  - $ref: power-supply.yaml#

additionalProperties: false

examples:
  - |
    #include <dt-bindings/spmi/spmi.h>

    pmic@2 {
      compatible = "qcom,pmi8998", "qcom,spmi-pmic";
      reg = <0x2 SPMI_USID>;
      #address-cells = <1>;
      #size-cells = <0>;

      fuel-gauge@4000 {
        compatible = "qcom,pmi8998-fg";
        reg = <0x4000>;
        monitored-battery = <&battery>;
        power-supplies = <&charger>;
      };
    };
```
